#include <dt-bindings/zmk/matrix_transform.h>

/ {
    chosen {
        zmk,kscan = &default_kscan;
    };

    default_kscan: kscan {
        compatible = "zmk,kscan-gpio-matrix";
        label = "default_kscan";
        diode-direction = "col2row";

        row-gpios = <&seeeduino_xiao_ble 10 (GPIO_ACTIVE_HIGH | GPIO_PULL_DOWN)>,
                    <&seeeduino_xiao_ble 9 (GPIO_ACTIVE_HIGH | GPIO_PULL_DOWN)>,
                    <&seeeduino_xiao_ble 8 (GPIO_ACTIVE_HIGH | GPIO_PULL_DOWN)>,
                    <&seeeduino_xiao_ble 7 (GPIO_ACTIVE_HIGH | GPIO_PULL_DOWN)>;

        col-gpios = <&seeeduino_xiao_ble 6 GPIO_ACTIVE_HIGH >,
                    <&seeeduino_xiao_ble 5 GPIO_ACTIVE_HIGH >,
                    <&seeeduino_xiao_ble 4 GPIO_ACTIVE_HIGH >,
                    <&seeeduino_xiao_ble 3 GPIO_ACTIVE_HIGH >,
                    <&seeeduino_xiao_ble 2 GPIO_ACTIVE_HIGH >;
    };
}